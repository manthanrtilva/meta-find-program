## conf/layer.conf
```bitbake
# We have a conf and classes directory, add to BBPATH
BBPATH .= ":${LAYERDIR}"

# We have recipes-* directories, add to BBFILES
BBFILES += "${LAYERDIR}/recipes-*/*/*.bb \
            ${LAYERDIR}/recipes-*/*/*.bbappend"

BBFILE_COLLECTIONS += "meta-find-program"
BBFILE_PATTERN_meta-find-program = "^${LAYERDIR}/"
BBFILE_PRIORITY_meta-find-program = "6"

LAYERDEPENDS_meta-find-program = "core"
LAYERSERIES_COMPAT_meta-find-program = "mickledore scarthgap"
```
